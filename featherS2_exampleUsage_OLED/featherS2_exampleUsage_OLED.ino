/*
 * Copyright (c) 2021, Sensirion AG
 * All rights reserved.
 *
 * Redistribution and use in source and binary forms, with or without
 * modification, are permitted provided that the following conditions are met:
 *
 * * Redistributions of source code must retain the above copyright notice, this
 *   list of conditions and the following disclaimer.
 *
 * * Redistributions in binary form must reproduce the above copyright notice,
 *   this list of conditions and the following disclaimer in the documentation
 *   and/or other materials provided with the distribution.
 *
 * * Neither the name of Sensirion AG nor the names of its
 *   contributors may be used to endorse or promote products derived from
 *   this software without specific prior written permission.
 *
 * THIS SOFTWARE IS PROVIDED BY THE COPYRIGHT HOLDERS AND CONTRIBUTORS "AS IS"
 * AND ANY EXPRESS OR IMPLIED WARRANTIES, INCLUDING, BUT NOT LIMITED TO, THE
 * IMPLIED WARRANTIES OF MERCHANTABILITY AND FITNESS FOR A PARTICULAR PURPOSE
 * ARE DISCLAIMED. IN NO EVENT SHALL THE COPYRIGHT HOLDER OR CONTRIBUTORS BE
 * LIABLE FOR ANY DIRECT, INDIRECT, INCIDENTAL, SPECIAL, EXEMPLARY, OR
 * CONSEQUENTIAL DAMAGES (INCLUDING, BUT NOT LIMITED TO, PROCUREMENT OF
 * SUBSTITUTE GOODS OR SERVICES; LOSS OF USE, DATA, OR PROFITS; OR BUSINESS
 * INTERRUPTION) HOWEVER CAUSED AND ON ANY THEORY OF LIABILITY, WHETHER IN
 * CONTRACT, STRICT LIABILITY, OR TORT (INCLUDING NEGLIGENCE OR OTHERWISE)
 * ARISING IN ANY WAY OUT OF THE USE OF THIS SOFTWARE, EVEN IF ADVISED OF THE
 * POSSIBILITY OF SUCH DAMAGE.
 */

 /*
 * dusjagr edited some stuffs...
 * Adding display
 * Adding timer
 * Not finished: add buttons, and external Temp-probe
 * Not finished: proper calibration routine
 * 
 */

#include <Arduino.h>
#include <SensirionI2CScd4x.h>
#include <Wire.h>

uint16_t alt = 113;
float tempOffset = 4.5;


// OLED stuffs **********************

#include <Adafruit_SSD1306.h>

#define OLED_RESET 4
#define SCREEN_WIDTH 128 // OLED display width, in pixels
#define SCREEN_HEIGHT 64 // OLED display height, in pixels
uint32_t displayLimit = 1400;
uint32_t displayFactor = displayLimit / 48;
uint32_t meas_counter = 0;
int32_t thresholdPPM = 450;
Adafruit_SSD1306 display(SCREEN_WIDTH, SCREEN_HEIGHT, &Wire, OLED_RESET);

// """"""""""""""""""""""""""""""""""

SensirionI2CScd4x scd4x;

unsigned long getDataTimer = 0;
unsigned long TimeSec = 0;
unsigned long timeElapse = 0;//used to wait the sensor to stabilize before calibration

void printUint16Hex(uint16_t value) {
    Serial.print(value < 4096 ? "0" : "");
    Serial.print(value < 256 ? "0" : "");
    Serial.print(value < 16 ? "0" : "");
    Serial.print(value, HEX);
}

void printSerialNumber(uint16_t serial0, uint16_t serial1, uint16_t serial2) {
    Serial.print("Serial: 0x");
    printUint16Hex(serial0);
    printUint16Hex(serial1);
    printUint16Hex(serial2);
    Serial.println();
}

void setup() {

    Serial.begin(115200);
    while (!Serial) {
        delay(100);
    }
    
    initDisplay();

    showLogo_humus_text();
    delay(1000);
    showLogo_oursci();
    delay(1000);
    showLogo_hackteria();
    delay(1000);
    OLEDdrawBackground();
    
    Wire.begin();

    uint16_t error;
    char errorMessage[256];

    scd4x.begin(Wire);

    // stop potentially previously started measurement
    error = scd4x.stopPeriodicMeasurement();
    if (error) {
        Serial.print("Error trying to execute stopPeriodicMeasurement(): ");
        errorToString(error, errorMessage, 256);
        Serial.println(errorMessage);
    }

    uint16_t serial0;
    uint16_t serial1;
    uint16_t serial2;
    error = scd4x.getSerialNumber(serial0, serial1, serial2);
    if (error) {
        Serial.print("Error trying to execute getSerialNumber(): ");
        errorToString(error, errorMessage, 256);
        Serial.println(errorMessage);
    } else {                                                                                                           
        printSerialNumber(serial0, serial1, serial2);
    }

// Some settings **************************************
    
    scd4x.setSensorAltitude(alt);
    scd4x.setTemperatureOffset(tempOffset);
    scd4x.setAutomaticSelfCalibration(false);
    Serial.println("AutoSelfCalibrations is off");

    uint16_t setAlt;
    error = scd4x.getSensorAltitude(setAlt);
    if (error) {
        Serial.print("Error trying: ");
        errorToString(error, errorMessage, 256);
        Serial.println(errorMessage);
    } else {
        Serial.print("Altitude is set to: ");
        Serial.println(setAlt);
    }

    float settempOffset;
    error = scd4x.getTemperatureOffset(settempOffset);
    if (error) {
        Serial.print("Error trying: ");
        errorToString(error, errorMessage, 256);
        Serial.println(errorMessage);
    } else {
        Serial.print("Temperature Offset set to: ");
        Serial.println(settempOffset);
    }

// Force Calibration **************************************

   /**
     * performForcedRecalibration() - To successfully conduct an accurate forced
    recalibration, the following steps need to be carried out:
    1. Operate the SCD4x in a periodic measurement mode for > 3 minutes in an
    environment with homogenous and constant CO₂ concentration.
    2. Stop periodic measurement. Wait 500 ms.
    3. Subsequently issue the perform_forced_recalibration command and
    optionally read out the baseline correction. A return value of 0xffff
    indicates that the forced recalibration failed.
     *
     * @param targetCo2Concentration Target CO₂ concentration in ppm.
     *
     * @param frcCorrection FRC correction value in CO₂ ppm or 0xFFFF if the
    command failed. Convert value to CO₂ ppm with: value - 0x8000
     *
     * @return 0 on success, an error code otherwise
     */

/*
    uint16_t calPPM = 500;
    uint16_t frc;
    error = scd4x.performForcedRecalibration(calPPM, frc);
    if (error) {
        Serial.print("Error trying: ");
        errorToString(error, errorMessage, 256);
        Serial.println(errorMessage);
    } else {
        Serial.print("Changed calibration by: ");
        Serial.println(frc-0x8000);
    }
    delay(400);
*/ 

// Start Measurement **************************************

    error = scd4x.startPeriodicMeasurement();
    if (error) {
        Serial.print("Error trying to execute startPeriodicMeasurement(): ");
        errorToString(error, errorMessage, 256);
        Serial.println(errorMessage);
    }

    Serial.println("Waiting for first measurement... (5 sec)");
    delay(5000);
}

void loop() {
    uint16_t error;
    char errorMessage[256];

    if (millis() - getDataTimer >= 5000){

    // Read Measurement
    uint16_t co2;
    float temperature;
    float humidity;
    error = scd4x.readMeasurement(co2, temperature, humidity);
    if (error) {
        Serial.print("Error trying to execute readMeasurement(): ");
        errorToString(error, errorMessage, 256);
        Serial.println(errorMessage);
    } else if (co2 == 0) {
        Serial.println("Invalid sample detected, skipping.");
    } else {
        getDataTimer = millis();
        TimeSec = getDataTimer / 1000;
        Serial.print("TimeSec:");
        Serial.print(TimeSec);
        Serial.print("\t");
        Serial.print("Co2:");
        Serial.print(co2);
        Serial.print("\t");
        Serial.print("Temperature:");
        Serial.print(temperature);
        Serial.print("\t");
        Serial.print("Humidity:");
        Serial.println(humidity);
        }


    OLEDshowCO2(co2, temperature, humidity);
    meas_counter++;
    }
    
    
}

// 'our-sci_logo', 128x64px  made with http://javl.github.io/image2cpp/
const unsigned char oursci_logo [] PROGMEM = {
  0x00, 0x00, 0x00, 0x00, 0x00, 0x00, 0x00, 0x00, 0x00, 0x00, 0x00, 0x00, 0x00, 0x00, 0x00, 0x00, 
  0x00, 0x00, 0x00, 0x00, 0x00, 0x00, 0x00, 0x00, 0x00, 0x00, 0x00, 0x00, 0x00, 0x00, 0x00, 0x00, 
  0x00, 0x00, 0x00, 0x00, 0x00, 0x00, 0x00, 0x00, 0x00, 0x00, 0x00, 0x00, 0x00, 0x00, 0x00, 0x00, 
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  0x00, 0x00, 0x00, 0x00, 0x00, 0x00, 0x00, 0x07, 0x00, 0x00, 0x00, 0x00, 0x00, 0x00, 0x00, 0x00
};

const unsigned char hackteria_logo [] PROGMEM = {
  // 'hackteria_logo, 128x64px
  0x00, 0x00, 0x00, 0x00, 0x00, 0x00, 0x00, 0x00, 0x00, 0x00, 0x00, 0x00, 0x00, 0x00, 0x00, 0x00, 
  0x00, 0x00, 0x00, 0x00, 0x00, 0x00, 0x00, 0x00, 0x00, 0x00, 0x00, 0x00, 0x00, 0x00, 0x00, 0x00,
  0x00, 0x00, 0x00, 0x00, 0x00, 0x00, 0x00, 0x00, 0x00, 0x00, 0x00, 0x00, 0x00, 0x00, 0x00, 0x00, 
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  0x00, 0x00, 0x00, 0x00, 0x00, 0x00, 0x00, 0x7f, 0xf8, 0x00, 0x00, 0x00, 0x00, 0x00, 0x00, 0x00
};

// 'humus_logo', 128x64px
const unsigned char humus_logo [] PROGMEM = {
  0x00, 0x00, 0x00, 0x00, 0x00, 0x00, 0x00, 0x00, 0x00, 0x00, 0x00, 0x00, 0x00, 0x00, 0x00, 0x00, 
  0x00, 0x00, 0x00, 0x00, 0x00, 0x00, 0x00, 0x00, 0x00, 0x00, 0x00, 0x00, 0x00, 0x00, 0x00, 0x00, 
  0x00, 0x00, 0x00, 0x00, 0x00, 0x00, 0x00, 0x00, 0x00, 0x00, 0x00, 0x00, 0x00, 0x00, 0x00, 0x00, 
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  0x7f, 0xff, 0xf3, 0xff, 0xff, 0xff, 0xff, 0xff, 0xff, 0xff, 0xff, 0xff, 0xff, 0xff, 0xff, 0xff
};

// 'humus_logo_plant', 128x64px
const unsigned char humus_logo_plant [] PROGMEM = {
  0x00, 0x00, 0x00, 0x00, 0x00, 0x00, 0x00, 0x00, 0x00, 0x00, 0x00, 0x00, 0x00, 0x00, 0x00, 0x00, 
  0x00, 0x00, 0x00, 0x00, 0x00, 0x00, 0x00, 0x00, 0x00, 0x00, 0x00, 0x00, 0x00, 0x00, 0x00, 0x00, 
  0x00, 0x00, 0x00, 0x00, 0x00, 0x00, 0x00, 0x00, 0x00, 0x00, 0x00, 0x00, 0x00, 0x00, 0x00, 0x00, 
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  0x7f, 0xff, 0xf0, 0x00, 0x00, 0x00, 0x00, 0x00, 0x00, 0x00, 0x00, 0x00, 0x00, 0x00, 0x00, 0x00
};

// OLED stuffs **********************

void initDisplay()
{
    display.begin(SSD1306_SWITCHCAPVCC, 0x3C);
    display.clearDisplay();
    display.setTextSize(2);
    display.setTextColor(WHITE);
    display.setCursor(0, 25);
    display.println("AirQuality");
    display.setTextSize(1);
    display.setCursor(0, 46);
    display.println("BME280 Temp/Hum");
    display.setCursor(0, 56);
    display.println("CCS811 CO2 Sensor");
    display.setTextSize(2);
    display.setCursor(0, 0);
    display.println("ABC");
    display.display();
}

void showLogo_oursci(){
  display.clearDisplay(); // Make sure the display is cleared
  display.drawBitmap(0, 0, oursci_logo, 128, 64, WHITE);  
  display.setTextSize(2);
  display.setTextColor(WHITE);
  display.setCursor(24,0);
  display.println("OUR-SCI");
  // Update the display
  display.display();
  delay(30);
}

void showLogo_hackteria(){
  display.clearDisplay(); // Make sure the display is cleared
  display.drawBitmap(0, 0, hackteria_logo, 128, 64, WHITE);  
  display.setTextSize(2);
  display.setTextColor(WHITE);
  display.setCursor(11,0);
  display.println("HACKTERIA");
  // Update the display
  display.display();
  delay(30);
}

void showLogo_humus(){
  display.clearDisplay(); // Make sure the display is cleared
  display.drawBitmap(0, 0, humus_logo, 128, 64, WHITE);  
  // Update the display
  display.display();
  delay(30);
}

void showLogo_humus_text(){
  display.clearDisplay(); // Make sure the display is cleared
  display.drawBitmap(0, 0, humus_logo, 128, 64, WHITE);  
  display.setTextSize(1);
  display.setTextColor(WHITE);
  display.setCursor(38,17);
  display.println("CO2 Respiration");
  display.setTextSize(2);
  display.setTextColor(WHITE);
  display.setCursor(20,0);
  display.println("ROSA CO2");
  // Update the display
  display.display();
  delay(30);
}

void showLogo_humus_plant(){
  //display.clearDisplay(); // Make sure the display is cleared
  display.drawBitmap(0, 0, humus_logo_plant, 128, 64, WHITE);  
  // Update the display
  //display.display();
  delay(30);
}

void OLEDdrawBackground()
{
    display.clearDisplay();
    for (int i = 28; i <= 128; i = i + 3) {
        display.drawPixel(i, 64 - (400 / displayFactor), WHITE);
    }
    for (int i = 28; i <= 128; i = i + 5) {
        display.drawPixel(i, 64 - ((displayLimit-200) / displayFactor), WHITE);
    }
    /*
    for (int i = 28; i <= 128; i = i + 7) {
        display.drawPixel(i, 64 - (3000 / displayFactor), WHITE);
    }
    */
    display.drawRect(28, 16, 100, 48, 1); //Border of the bar chart

    display.setTextSize(1);
    display.setTextColor(WHITE);
    display.setCursor(100, 21);
    display.println(displayLimit-200);
    display.setCursor(108, 46);
    display.println("400");
    display.setTextSize(1);
    display.fillRect(29, 46, 70, 17, BLACK);
    display.setCursor(30, 47);
    //display.println("HUMUS.Sapiens");
    display.setCursor(36, 55);
    display.println("CO2 Respiration");
    display.drawBitmap(0, 0, humus_logo_plant, 128, 64, WHITE);
    display.display();
}

void OLEDshowCO2(uint16_t ppm, float temp, float hum)
{   int tempRound = temp;
    int humRound = hum;
    display.setTextSize(1);
    display.fillRect(0, 0, 128, 16, BLACK);
    display.setTextColor(WHITE);
    display.setCursor(38, 0);
    display.println("CO2");
    display.setCursor(38, 7);
    display.println("ppm");
    display.setTextSize(2);
    display.setCursor(56, 0);
    display.print(":");
    display.print(ppm);
    display.setTextSize(1);
    display.setCursor(4, 0);
    display.print(tempRound);
    display.println("T");
    display.setCursor(4, 9);
    display.print(humRound);
    display.println("%");
/*
    if (meas_counter > 0) {
        display.drawLine(meas_counter - 1 + 28, 64 - last_ppm_high_res() / displayFactor, meas_counter + 28, 64 - current->ppm / displayFactor, WHITE);
    }
*/
    if (meas_counter > 0) {
        display.drawLine(meas_counter - 0 + 28, 64 - 400 / displayFactor, meas_counter + 28, 64 - ppm / displayFactor, WHITE);
    }

    if (meas_counter > 100) {
        meas_counter = 0;
        OLEDdrawBackground();
    }
/*
    if (ppm > thresholdPPM) {
        if (last_ppm_high_res() < thresholdPPM) {
            display.setTextSize(1);
            display.setCursor(h_head + 3, thresholdPPM / displayFactor + 10);
            display.print((millis() - started) / 1000);
            display.println("s");
        }
    }
*/

    display.display();
    delay(300);
}

// """""

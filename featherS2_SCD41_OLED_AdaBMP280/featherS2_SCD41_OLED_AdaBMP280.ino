/*
 * Copyright (c) 2021, Sensirion AG
 * All rights reserved.
 *
 * Redistribution and use in source and binary forms, with or without
 * modification, are permitted provided that the following conditions are met:
 *
 * * Redistributions of source code must retain the above copyright notice, this
 *   list of conditions and the following disclaimer.
 *
 * * Redistributions in binary form must reproduce the above copyright notice,
 *   this list of conditions and the following disclaimer in the documentation
 *   and/or other materials provided with the distribution.
 *
 * * Neither the name of Sensirion AG nor the names of its
 *   contributors may be used to endorse or promote products derived from
 *   this software without specific prior written permission.
 *
 * THIS SOFTWARE IS PROVIDED BY THE COPYRIGHT HOLDERS AND CONTRIBUTORS "AS IS"
 * AND ANY EXPRESS OR IMPLIED WARRANTIES, INCLUDING, BUT NOT LIMITED TO, THE
 * IMPLIED WARRANTIES OF MERCHANTABILITY AND FITNESS FOR A PARTICULAR PURPOSE
 * ARE DISCLAIMED. IN NO EVENT SHALL THE COPYRIGHT HOLDER OR CONTRIBUTORS BE
 * LIABLE FOR ANY DIRECT, INDIRECT, INCIDENTAL, SPECIAL, EXEMPLARY, OR
 * CONSEQUENTIAL DAMAGES (INCLUDING, BUT NOT LIMITED TO, PROCUREMENT OF
 * SUBSTITUTE GOODS OR SERVICES; LOSS OF USE, DATA, OR PROFITS; OR BUSINESS
 * INTERRUPTION) HOWEVER CAUSED AND ON ANY THEORY OF LIABILITY, WHETHER IN
 * CONTRACT, STRICT LIABILITY, OR TORT (INCLUDING NEGLIGENCE OR OTHERWISE)
 * ARISING IN ANY WAY OUT OF THE USE OF THIS SOFTWARE, EVEN IF ADVISED OF THE
 * POSSIBILITY OF SUCH DAMAGE.
 */

 /*
 * dusjagr edited some stuffs...
 * Adding display
 * Adding timer
 * Adding BMP280 pressure sensor
 * Not finished: add buttons, and external Temp-probe
 * Not finished: proper calibration routine
 * 
 */

#define BMP_IS_ATTACHED

#include <Arduino.h>
#include <SensirionI2CScd4x.h>
#include <Wire.h>

const int LEDonBoard = 13;      // the number of the LED pin
const int LEDexternal = 33;      // the number of the LED pin
int ledState = LOW;             // ledState used to set the LED

// SCD41 calibration settings *******
// ==================================

uint16_t alt = 115;
uint32_t pressureCalibration;
float tempOffset = 3.5;
bool ascSetting = false; // Turn automatic self calibration off

// BMP280 stuffs ********************
// ==================================

#ifdef BMP_IS_ATTACHED
  #include <Adafruit_BMP280.h>
  Adafruit_BMP280 bmp; // I2C

  #define SEA_LEVEL_PRESSURE    1010.0f   // sea level pressure 1013.25

  float BMP280temp;
  uint32_t BMP280pres;
  float BMP280alti;
#endif

// OLED stuffs **********************
// ==================================

#include <Adafruit_GFX.h>
#include <Adafruit_SSD1306.h>

#define OLED_RESET 4
#define SCREEN_ADDRESS 0x3C
#define SCREEN_WIDTH 128 // OLED display width, in pixels
#define SCREEN_HEIGHT 64 // OLED display height, in pixels
uint32_t displayLimit = 1400;
uint32_t displayFactor = displayLimit / 48;
uint32_t meas_counter = 0;
int32_t thresholdPPM = 450;

Adafruit_SSD1306 display(SCREEN_WIDTH, SCREEN_HEIGHT, &Wire, OLED_RESET);

// """"""""""""""""""""""""""""""""""

SensirionI2CScd4x scd4x;

unsigned long getDataTimer = 0;
unsigned long TimeSec = 0;
unsigned long timeElapse = 0;//used to wait the sensor to stabilize before calibration
uint16_t error;
char errorMessage[256];
uint16_t co2;
float temperature;
float humidity;

void printUint16Hex(uint16_t value) {
    Serial.print(value < 4096 ? "0" : "");
    Serial.print(value < 256 ? "0" : "");
    Serial.print(value < 16 ? "0" : "");
    Serial.print(value, HEX);
}

void printSerialNumber(uint16_t serial0, uint16_t serial1, uint16_t serial2) {
    Serial.print("Serial: 0x");
    printUint16Hex(serial0);
    printUint16Hex(serial1);
    printUint16Hex(serial2);
    Serial.println();
}

void setup() {
    
    Serial.begin(115200);
    //while ( !Serial ) delay(100);   // wait for native usb

    pinMode(LEDonBoard, OUTPUT);
    digitalWrite(LEDonBoard, HIGH);
    pinMode(LEDexternal, OUTPUT);
    digitalWrite(LEDexternal, HIGH);

    Serial.println("    ");
    Serial.println("=========== Initializing OLED Screen ===========");
    initDisplay();
    delay(100);

    showLogo_hackteria();
    delay(1000);

    Serial.println("======== Testing BMP280 Pressure Sensor ========");
    
#ifndef BMP_IS_ATTACHED
    Serial.println("BMP280 not in use");
    OLEDtestBMP280();
    delay(500);
    OLEDnoBMP280();
    delay(2000);
#endif

#ifdef BMP_IS_ATTACHED
    unsigned status;
    Serial.println("BMP280: begin");
    status = bmp.begin(0x76, BMP280_CHIPID);
    
    OLEDtestBMP280();
    delay(500);
    if (!status) {
      Serial.println(F("Could not find a valid BMP280 sensor, check wiring or "
                      "try a different address!"));
      Serial.print("SensorID was: 0x"); Serial.println(bmp.sensorID(),16);
      Serial.print("        ID of 0xFF probably means a bad address, a BMP 180 or BMP 085\n");
      Serial.print("   ID of 0x56-0x58 represents a BMP 280,\n");
      Serial.print("        ID of 0x60 represents a BME 280.\n");
      Serial.print("        ID of 0x61 represents a BME 680.\n");
      Serial.print("        ID of 0x76 represents a BME 680.\n");
      showError(); //ERROR
      delay(3000);
    } else {
        Serial.println("BMP280 connected successfully");
        OLEDtestSuccess();
        delay(500);
    }
       
    /* Default settings from datasheet. */
    bmp.setSampling(Adafruit_BMP280::MODE_NORMAL,       /* Operating Mode. */
                    Adafruit_BMP280::SAMPLING_X2,       /* Temp. oversampling */
                    Adafruit_BMP280::SAMPLING_X16,      /* Pressure oversampling */
                    Adafruit_BMP280::FILTER_X16,        /* Filtering. */
                    Adafruit_BMP280::STANDBY_MS_500);   /* Standby time. */
    delay(100);
    
    Serial.println("BMP280: read once");
    while (true) {
    Serial.print("Temperature: ");
    Serial.print(bmp.readTemperature());
    Serial.print(" *C");

    Serial.print("\t Pressure = ");
    Serial.print(bmp.readPressure());
    Serial.print(" Pa");

    Serial.print("\t Approx altitude = ");
    Serial.print(bmp.readAltitude(SEA_LEVEL_PRESSURE)); /* Adjusted to local forecast! */
    Serial.print(" m");
    Serial.println();
    
    OLEDshowBMP280(bmp.readPressure(), bmp.readTemperature(), bmp.readAltitude(SEA_LEVEL_PRESSURE));
    delay(300);
    }
    Serial.println("==================  end test  ==================");
    Serial.println();
    
#endif
    
    Serial.println("=========== Testing SCD41 CO2 Sensor ===========");
    Serial.println("SCD41: begin");
    OLEDtestSCD41();
    delay(500);
    scd4x.begin(Wire);

    // stop potentially previously started measurement
    error = scd4x.stopPeriodicMeasurement();
    if (error) {
        Serial.print("Error trying to execute stopPeriodicMeasurement(): ");
        errorToString(error, errorMessage, 256);
        Serial.println(errorMessage);
        showError(); //ERROR
        delay(3000);
    } else {
        OLEDtestSuccess();
        delay(500);
    }
    

    uint16_t serial0;
    uint16_t serial1;
    uint16_t serial2;
    error = scd4x.getSerialNumber(serial0, serial1, serial2);
    if (error) {
        Serial.print("Error trying to execute getSerialNumber(): ");
        errorToString(error, errorMessage, 256);
        Serial.println(errorMessage);
    } else {
        Serial.println("SCD41 connected succesfully");                                                                                                           
        printSerialNumber(serial0, serial1, serial2);
    }

// Some settings **************************************
    
    scd4x.setSensorAltitude(alt);
    //scd4x.setAmbientPressure(pressureCalibration);
    scd4x.setTemperatureOffset(tempOffset);
    scd4x.setAutomaticSelfCalibration(ascSetting);
    
    uint16_t ascEnabled;
    error = scd4x.getAutomaticSelfCalibration(ascEnabled);
    if (error) {
        Serial.print("Error trying: ");
        errorToString(error, errorMessage, 256);
        Serial.println(errorMessage);
    } else {
        Serial.print("AutoSelfCalibrations is: ");
        if (ascEnabled) Serial.println("ON");
        if (!ascEnabled) Serial.println("OFF");
    }
    
    uint16_t setAlt;
    error = scd4x.getSensorAltitude(setAlt);
    if (error) {
        Serial.print("Error trying: ");
        errorToString(error, errorMessage, 256);
        Serial.println(errorMessage);
    } else {
        Serial.print("Altitude is set to: ");
        Serial.println(setAlt);
    }

    float settempOffset;
    error = scd4x.getTemperatureOffset(settempOffset);
    if (error) {
        Serial.print("Error trying: ");
        errorToString(error, errorMessage, 256);
        Serial.println(errorMessage);
    } else {
        Serial.print("Temperature Offset set to: ");
        Serial.println(settempOffset);
    }
    
// Force Calibration **************************************

   /**
     * performForcedRecalibration() - To successfully conduct an accurate forced
    recalibration, the following steps need to be carried out:
    1. Operate the SCD4x in a periodic measurement mode for > 3 minutes in an
    environment with homogenous and constant CO₂ concentration.
    2. Stop periodic measurement. Wait 500 ms.
    3. Subsequently issue the perform_forced_recalibration command and
    optionally read out the baseline correction. A return value of 0xffff
    indicates that the forced recalibration failed.
     *
     * @param targetCo2Concentration Target CO₂ concentration in ppm.
     *
     * @param frcCorrection FRC correction value in CO₂ ppm or 0xFFFF if the
    command failed. Convert value to CO₂ ppm with: value - 0x8000
     *
     * @return 0 on success, an error code otherwise
     */
    
/*
    uint16_t calPPM = 550;
    uint16_t frc;
    error = scd4x.performForcedRecalibration(calPPM, frc);
    if (error) {
        Serial.print("Error trying: ");
        errorToString(error, errorMessage, 256);
        Serial.println(errorMessage);
    } else {
        Serial.print("Changed calibration by: ");
        Serial.println(frc-0x8000);
    }
    delay(400);

*/

// Start Measurement **************************************

    error = scd4x.startPeriodicMeasurement();
    if (error) {
        Serial.print("Error trying to execute startPeriodicMeasurement(): ");
        errorToString(error, errorMessage, 256);
        Serial.println(errorMessage);
    }
    Serial.println("==================  end test  ==================");

    Serial.println();
    Serial.println("Waiting for first measurement... (5 sec)");
    Serial.println(".");
    OLEDshowSCD41(ascEnabled, setAlt, settempOffset);
    delay(1000);
    Serial.println("..");
    delay(1000);
    OLEDstartMeasurements();
    Serial.println("...");
    delay(1000);
    showLogo_humus_text();
    Serial.println("....");
    delay(1000);
    Serial.println(".....");
    delay(1000);
        
    Serial.println("============= Starting Measurements ============");
    OLEDdrawBackground();
}

void loop() {

#ifdef BMP_IS_ATTACHED
    BMP280temp = bmp.readTemperature();
    BMP280pres = bmp.readPressure();
    BMP280alti = bmp.readAltitude(SEA_LEVEL_PRESSURE); /* Adjusted to local forecast! */

    uint32_t BMP280presPa = (BMP280pres * 1013.25)/1000;
    uint16_t BMP280preshPa = BMP280presPa / 100; 

    float calcAltitude;

    calcAltitude = 44330 * (1.0 - pow(BMP280presPa / 100 / SEA_LEVEL_PRESSURE, 0.1903));
#endif
 
    if (millis() - getDataTimer >= 5000){
    digitalWrite(LEDonBoard, HIGH);
    digitalWrite(LEDexternal, HIGH);
    // Read Measurement

    error = scd4x.readMeasurement(co2, temperature, humidity);
    if (error) {
        Serial.print("Error trying to execute readMeasurement(): ");
        errorToString(error, errorMessage, 256);
        Serial.println(errorMessage);
    } else if (co2 == 0) {
        Serial.println("Invalid sample detected, skipping.");
    } else {
        getDataTimer = millis();
        TimeSec = getDataTimer / 1000;
        Serial.print("TimeSec:");
        Serial.print(TimeSec);
        Serial.print("\t");
        Serial.print("Co2: ");
        Serial.print(co2);
        Serial.print("\t");
        Serial.print("Temp: ");
        Serial.print(temperature);
        Serial.print("\t");
        Serial.print("Hum%: ");
        Serial.print(humidity);
#ifdef BMP_IS_ATTACHED
        Serial.print("\t");
        Serial.print("BMB-Pres: ");
        Serial.print(BMP280pres);
        Serial.print("\t");
        Serial.print("BMP-Temp: ");
        Serial.print(BMP280temp);
        //Serial.print("\t");
        //Serial.print("recalc_to_hPa: ");
        //Serial.print(BMP280preshPa);
        Serial.print("\t");
        Serial.print("Alti: ");
        Serial.print(BMP280alti);
        //Serial.print("\t");
        //Serial.print("CalcAlti: ");
        //Serial.print(calcAltitude);
#endif
        Serial.println();
        }

    OLEDshowCO2(co2, temperature, humidity);

    meas_counter++;
    delay(300);
    digitalWrite(LEDonBoard, LOW);
    digitalWrite(LEDexternal, LOW);
    }
    
    
}

// 'our-sci_logo', 128x64px  made with http://javl.github.io/image2cpp/
const unsigned char oursci_logo [] PROGMEM = {
  0x00, 0x00, 0x00, 0x00, 0x00, 0x00, 0x00, 0x00, 0x00, 0x00, 0x00, 0x00, 0x00, 0x00, 0x00, 0x00, 
  0x00, 0x00, 0x00, 0x00, 0x00, 0x00, 0x00, 0x00, 0x00, 0x00, 0x00, 0x00, 0x00, 0x00, 0x00, 0x00, 
  0x00, 0x00, 0x00, 0x00, 0x00, 0x00, 0x00, 0x00, 0x00, 0x00, 0x00, 0x00, 0x00, 0x00, 0x00, 0x00, 
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  0x00, 0x00, 0x00, 0x00, 0x00, 0x00, 0x00, 0x07, 0x00, 0x00, 0x00, 0x00, 0x00, 0x00, 0x00, 0x00
};

const unsigned char hackteria_logo [] PROGMEM = {
  // 'hackteria_logo, 128x64px
  0x00, 0x00, 0x00, 0x00, 0x00, 0x00, 0x00, 0x00, 0x00, 0x00, 0x00, 0x00, 0x00, 0x00, 0x00, 0x00, 
  0x00, 0x00, 0x00, 0x00, 0x00, 0x00, 0x00, 0x00, 0x00, 0x00, 0x00, 0x00, 0x00, 0x00, 0x00, 0x00,
  0x00, 0x00, 0x00, 0x00, 0x00, 0x00, 0x00, 0x00, 0x00, 0x00, 0x00, 0x00, 0x00, 0x00, 0x00, 0x00, 
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  0x00, 0x00, 0x00, 0x00, 0x00, 0x00, 0x00, 0x7f, 0xf8, 0x00, 0x00, 0x00, 0x00, 0x00, 0x00, 0x00
};

// 'humus_logo', 128x64px
const unsigned char humus_logo [] PROGMEM = {
  0x00, 0x00, 0x00, 0x00, 0x00, 0x00, 0x00, 0x00, 0x00, 0x00, 0x00, 0x00, 0x00, 0x00, 0x00, 0x00, 
  0x00, 0x00, 0x00, 0x00, 0x00, 0x00, 0x00, 0x00, 0x00, 0x00, 0x00, 0x00, 0x00, 0x00, 0x00, 0x00, 
  0x00, 0x00, 0x00, 0x00, 0x00, 0x00, 0x00, 0x00, 0x00, 0x00, 0x00, 0x00, 0x00, 0x00, 0x00, 0x00, 
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  0x7f, 0xff, 0xf3, 0xff, 0xff, 0xff, 0xff, 0xff, 0xff, 0xff, 0xff, 0xff, 0xff, 0xff, 0xff, 0xff
};

// 'humus_logo_plant', 128x64px
const unsigned char humus_logo_plant [] PROGMEM = {
  0x00, 0x00, 0x00, 0x00, 0x00, 0x00, 0x00, 0x00, 0x00, 0x00, 0x00, 0x00, 0x00, 0x00, 0x00, 0x00, 
  0x00, 0x00, 0x00, 0x00, 0x00, 0x00, 0x00, 0x00, 0x00, 0x00, 0x00, 0x00, 0x00, 0x00, 0x00, 0x00, 
  0x00, 0x00, 0x00, 0x00, 0x00, 0x00, 0x00, 0x00, 0x00, 0x00, 0x00, 0x00, 0x00, 0x00, 0x00, 0x00, 
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  0x7f, 0xff, 0xf0, 0x00, 0x00, 0x00, 0x00, 0x00, 0x00, 0x00, 0x00, 0x00, 0x00, 0x00, 0x00, 0x00
};

// OLED stuffs **********************

void initDisplay()
{  /* SSD1306_SWITCHCAPVCC = generate display voltage from 3.3V internally
    if(!display.begin(SSD1306_SWITCHCAPVCC, 0x3C)) {
    Serial.println(F("SSD1306 allocation failed"));
    for(;;); // Don't proceed, loop forever
     } 
     */
    display.begin(SSD1306_SWITCHCAPVCC, 0x3C);
    display.clearDisplay();
    display.display();
}

void showLogo_oursci(){
  display.clearDisplay(); // Make sure the display is cleared
  display.drawBitmap(0, 0, oursci_logo, 128, 64, WHITE);  
  display.setTextSize(2);
  display.setTextColor(WHITE);
  display.setCursor(24,0);
  display.println("OUR-SCI");
  // Update the display
  display.display();
  delay(30);
}

void showLogo_hackteria(){
  display.clearDisplay(); // Make sure the display is cleared
  display.drawBitmap(0, 0, hackteria_logo, 128, 64, WHITE);  
  display.setTextSize(2);
  display.setTextColor(WHITE);
  display.setCursor(11,0);
  display.println("HACKTERIA");
  // Update the display
  display.display();
  delay(30);
}

void OLEDtestBMP280(){
  display.clearDisplay(); // Make sure the display is cleared
  display.setTextSize(1);
  display.setTextColor(WHITE);
  display.setCursor(4, 0);
  display.println("BPM");
  display.setCursor(4, 9);
  display.println("280");
  display.setTextColor(WHITE);
  display.setCursor(24,0);
  display.println(" >>  Test BPM280");
  display.display();
  delay(30);
}

void OLEDnoBMP280(){
  display.setTextSize(1);
  display.setTextColor(WHITE);
  display.setCursor(24,9);
  display.println(" >>  NOT IN USE");
  display.display();
  delay(30);
}

void OLEDtestSCD41(){
  display.clearDisplay(); // Make sure the display is cleared
  display.setTextSize(1);
  display.setTextColor(WHITE);
  display.setCursor(4, 0);
  display.println("SCD");
  display.setCursor(4, 9);
  display.println("41");
  display.setTextColor(WHITE);
  display.setCursor(24,0);
  display.println(" >>  Test SCD41");
  display.display();
  delay(30);
}

void OLEDtestSuccess(){
  //display.clearDisplay(); // Make sure the display is cleared
  display.setTextSize(1);
  display.setTextColor(WHITE);
  display.setCursor(24,9);
  display.println("     # SUCCESS ");
  display.display();
  delay(30);
}

void showError(){
 
  display.setTextSize(2);
  display.setTextColor(WHITE);
  display.setCursor(30,32);
  display.println("ERROR");
  // Update the display
  display.display();
  delay(30);
}

void OLEDstartMeasurements(){
  display.clearDisplay(); // Make sure the display is cleared
  display.setTextSize(1);
  display.setTextColor(WHITE);
  display.setCursor(10,0);
  display.println("Start Measurements");
  display.display();
  delay(30);
}

void showLogo_humus(){
  display.clearDisplay(); // Make sure the display is cleared
  display.drawBitmap(0, 0, humus_logo, 128, 64, WHITE);  
  // Update the display
  display.display();
  delay(30);
}

void showLogo_humus_text(){
  display.clearDisplay(); // Make sure the display is cleared
  display.drawBitmap(0, 0, humus_logo, 128, 64, WHITE);  
  display.setTextSize(1);
  display.setTextColor(WHITE);
  display.setCursor(38,17);
  display.println("CO2 Respiration");
  display.setTextSize(2);
  display.setTextColor(WHITE);
  display.setCursor(20,0);
  display.println("ROSA CO2");
  // Update the display
  display.display();
  delay(30);
}

void showLogo_humus_plant(){
  //display.clearDisplay(); // Make sure the display is cleared
  display.drawBitmap(0, 0, humus_logo_plant, 128, 64, WHITE);  
  // Update the display
  //display.display();
  delay(30);
}

void OLEDdrawBackground()
{
    display.clearDisplay();
    for (int i = 28; i <= 128; i = i + 3) {
        display.drawPixel(i, 64 - (400 / displayFactor), WHITE);
    }
    for (int i = 28; i <= 128; i = i + 5) {
        display.drawPixel(i, 64 - ((displayLimit-200) / displayFactor), WHITE);
    }
    /*
    for (int i = 28; i <= 128; i = i + 7) {
        display.drawPixel(i, 64 - (3000 / displayFactor), WHITE);
    }
    */
    display.drawRect(28, 16, 100, 48, 1); //Border of the bar chart

    display.setTextSize(1);
    display.setTextColor(WHITE);
    display.setCursor(100, 21);
    display.println(displayLimit-200);
    display.setCursor(108, 46);
    display.println("400");
    display.setTextSize(1);
    display.fillRect(29, 46, 70, 17, BLACK);
    display.setCursor(30, 47);
    //display.println("HUMUS.Sapiens");
    display.setCursor(36, 55);
    display.println("CO2 Respiration");
    display.drawBitmap(0, 0, humus_logo_plant, 128, 64, WHITE);
    display.display();
}

void OLEDshowCO2(uint16_t ppm, float temp, float hum)
{   int tempRound = temp;
    int humRound = hum;
    display.setTextSize(1);
    display.fillRect(0, 0, 128, 16, BLACK);
    display.setTextColor(WHITE);
    display.setCursor(38, 0);
    display.println("CO2");
    display.setCursor(38, 7);
    display.println("ppm");
    display.setTextSize(2);
    display.setCursor(56, 0);
    display.print(":");
    display.print(ppm);
    display.setTextSize(1);
    display.setCursor(4, 0);
    display.print(tempRound);
    display.println("T");
    display.setCursor(4, 9);
    display.print(humRound);
    display.println("%");
/*
    if (meas_counter > 0) {
        display.drawLine(meas_counter - 1 + 28, 64 - last_ppm_high_res() / displayFactor, meas_counter + 28, 64 - current->ppm / displayFactor, WHITE);
    }
*/
    if (meas_counter >= 0) {
        display.drawLine(meas_counter - 0 + 28, 64 - 400 / displayFactor, meas_counter + 28, 64 - ppm / displayFactor, WHITE);
    }

    if (meas_counter > 100) {
        meas_counter = 0;
        OLEDdrawBackground();
    }
/*
    if (ppm > thresholdPPM) {
        if (last_ppm_high_res() < thresholdPPM) {
            display.setTextSize(1);
            display.setCursor(h_head + 3, thresholdPPM / displayFactor + 10);
            display.print((millis() - started) / 1000);
            display.println("s");
        }
    }
*/

    display.display();
    delay(30);
}

void OLEDshowSCD41(uint16_t ascEnabled, uint16_t alt, float temp)
{   
    display.drawRect(28, 16, 100, 48, 1); //Border of the bar chart
    //display.drawBitmap(0, 0, humus_logo_plant, 128, 64, WHITE);
    display.setTextSize(1);
    display.setTextColor(WHITE);
    display.setCursor(4, 0);
    display.println("SCD");
    display.setCursor(4, 9);
    display.println("41");
    
    display.setCursor(32, 0+22);
    display.println("ASC");
    display.setCursor(70, 0+22);
    display.print(":");
    if (ascEnabled) display.print("ON");
    if (!ascEnabled) display.print("OFF");

    display.setCursor(32, 0+35);
    display.println("S.Temp");
    display.setCursor(70, 0+35);
    display.print(":");
    display.print(temp);
    display.println(" *C");

    display.setCursor(32, 0+48);
    display.println("S.Alt");    
    display.setCursor(70, 0+48);
    display.print(":");
    display.print(alt);
    display.println(" m");

    display.display();
    delay(30);
}

void OLEDshowBMP280(uint32_t pa, uint16_t temp, float alt)
{   int tempRound = temp;
    int altRound = alt;
    display.fillRect(0, 0, 128, 64, BLACK);
    display.drawRect(28, 16, 100, 48, 1); //Border of the bar chart
    display.drawBitmap(0, 0, humus_logo_plant, 128, 64, WHITE);
    
    display.setTextSize(1);
    display.setTextColor(WHITE);
    display.setCursor(4, 0);
    display.println("BMP");
    display.setCursor(4, 9);
    display.println("280");
    
    display.setCursor(32, 0+22);
    display.println("Pres");
    display.setCursor(56, 0+22);
    display.print(":");
    display.print(pa);
    display.println(" hPa");

    display.setCursor(32, 0+35);
    display.println("Temp");
    display.setCursor(56, 0+35);
    display.print(":");
    display.print(tempRound);
    display.println(" *C");

    display.setCursor(32, 0+48);
    display.println("Alt");    
    display.setCursor(56, 0+48);
    display.print(":");
    display.print(altRound);
    display.println(" m");

    display.display();
    delay(30);
}

// """""
